## ESP32/components/Davis-RFM69/Kconfig.projbuild
```kconfig
menu "Davis-RFM69 Configuration"

	config GPIO_RANGE_MAX
		int
		default 33 if IDF_TARGET_ESP32
		default 46 if IDF_TARGET_ESP32S2
		default 48 if IDF_TARGET_ESP32S3
		default 18 if IDF_TARGET_ESP32C2
		default 19 if IDF_TARGET_ESP32C3
		default 30 if IDF_TARGET_ESP32C6

	config MISO_GPIO
		int "RF69 MISO GPIO"
		range 0 GPIO_RANGE_MAX
		default 19 if IDF_TARGET_ESP32
		default 37 if IDF_TARGET_ESP32S2 || IDF_TARGET_ESP32S3
		default  4 # C3 and others
		help
			Pin Number to be used as the MISO SPI signal.

	config SCK_GPIO
		int "RF69 SCK GPIO"
		range 0 GPIO_RANGE_MAX
		default 18 if IDF_TARGET_ESP32
		default 36 if IDF_TARGET_ESP32S2 || IDF_TARGET_ESP32S3
		default  3 # C3 and others
		help
			Pin Number to be used as the SCK SPI signal.

	config MOSI_GPIO
		int "RF69 MOSI GPIO"
		range 0 GPIO_RANGE_MAX
		default 23 if IDF_TARGET_ESP32
		default 35 if IDF_TARGET_ESP32S2 || IDF_TARGET_ESP32S3
		default  2 # C3 and others
		help
			Pin Number to be used as the MOSI SPI signal.

	config NSS_GPIO
		int "RF69 NSS GPIO"
		range 0 GPIO_RANGE_MAX
		default  5 if IDF_TARGET_ESP32
		default 34 if IDF_TARGET_ESP32S2 || IDF_TARGET_ESP32S3
		default  1 # C3 and others
		help
			Pin Number to be used as the CSN SPI signal.

	config RST_GPIO
		int "RF69 RESTE GPIO"
		range 0 GPIO_RANGE_MAX
		default 16 if IDF_TARGET_ESP32
		default 38 if IDF_TARGET_ESP32S2 || IDF_TARGET_ESP32S3
		default  0 # C3 and others
		help
			Pin Number to be used as the RESET signal.
			
	config IRQ_GPIO
		int "RF69 IRQ GPIO"
		range 0 GPIO_RANGE_MAX
		default 27 if IDF_TARGET_ESP32
		default 38 if IDF_TARGET_ESP32S2 || IDF_TARGET_ESP32S3
		default  0 # C3 and others
		help
			Pin Number to be used as the RESET signal.

	choice SPI_HOST
		prompt "SPI peripheral that controls this bus"
		default SPI2_HOST
		help
			Select SPI peripheral that controls this bus.
		config SPI2_HOST
			bool "SPI2_HOST"
			help
				Use SPI2_HOST. This is also called HSPI_HOST.
		config SPI3_HOST
			depends on IDF_TARGET_ESP32 || IDF_TARGET_ESP32S2 || IDF_TARGET_ESP32S3
			bool "SPI3_HOST"
			help
				USE SPI3_HOST. This is also called VSPI_HOST
	endchoice

	choice
		prompt "Davis Frequency"
		default DAVIS_RFM69_FREQ_868
		help
				Select ISM band frequency
		config DAVIS_RFM69_FREQ_315
				bool "315 MHz" 
		config DAVIS_RFM69_FREQ_433
				bool "433 MHz" 
		config DAVIS_RFM69_FREQ_868
				bool "868 MHz" 
		config DAVIS_RFM69_FREQ_915
				bool "915 MHz" 
	endchoice
	
	choice
		prompt "Davis Region"
		default DAVIS_RFM69_FREQ_EU
		help
			"Select Region"
		config DAVIS_RFM69_FREQ_US
			bool "United States"
		config DAVIS_RFM69_FREQ_EU
			bool "Europe"
		config DAVIS_RFM69_FREQ_AU
			bool "Australia"
		config DAVIS_RFM69_FREQ_NZ
			bool "New Zealand"
	endchoice

	config DAVIS_RFM69_POWER_HIGH
		bool "Set TX power high(RFM69HW/RFM69HCW)"
		default y
		help
			If you are using a high power RF69 such as the RFM69HW, you must to set the TX power high.
			
	config DAVIS_RFM69_STATION_1
		bool "Listen to STATION_1"
		default n
		
	config DAVIS_RFM69_STATION_2
		bool "Listen to STATION_2"
		default n
		
	config DAVIS_RFM69_STATION_3
		bool "Listen to STATION_3"
		default n
		
	config DAVIS_RFM69_STATION_4
		bool "Listen to STATION_4"
		default n
		
	config DAVIS_RFM69_STATION_5
		bool "Listen to STATION_5"
		default n
		
	config DAVIS_RFM69_STATION_6
		bool "Listen to STATION_6"
		default n
		
	config DAVIS_RFM69_STATION_7
		bool "Listen to STATION_7"
		default n
		
	config DAVIS_RFM69_STATION_8
		bool "Listen to STATION_8"
		default n
	

endmenu
```

## ESP32/components/ttn-esp32/Kconfig.projbuild
```kconfig
menu "LoRaWAN Configuration"

	config LoRaWAN_GPIO_RANGE_MAX
		int
		default 39 if IDF_TARGET_ESP32
		default 46 if IDF_TARGET_ESP32S2
		default 48 if IDF_TARGET_ESP32S3
		default 18 if IDF_TARGET_ESP32C2
		default 19 if IDF_TARGET_ESP32C3
		default 30 if IDF_TARGET_ESP32C6

	config LoRaWAN_MISO_GPIO
		int "RFM95 MISO GPIO"
		range 0 LoRaWAN_GPIO_RANGE_MAX
		default 19 if IDF_TARGET_ESP32
		default 37 if IDF_TARGET_ESP32S2 || IDF_TARGET_ESP32S3
		default  4 # C3 and others
		help
			Pin Number to be used as the MISO SPI signal.

	config LoRaWAN_SCK_GPIO
		int "RFM95 SCK GPIO"
		range 0 LoRaWAN_GPIO_RANGE_MAX
		default 18 if IDF_TARGET_ESP32
		default 36 if IDF_TARGET_ESP32S2 || IDF_TARGET_ESP32S3
		default  3 # C3 and others
		help
			Pin Number to be used as the SCK SPI signal.

	config LoRaWAN_MOSI_GPIO
		int "RFM95 MOSI GPIO"
		range 0 LoRaWAN_GPIO_RANGE_MAX
		default 23 if IDF_TARGET_ESP32
		default 35 if IDF_TARGET_ESP32S2 || IDF_TARGET_ESP32S3
		default  2 # C3 and others
		help
			Pin Number to be used as the MOSI SPI signal.

	config LoRaWAN_NSS_GPIO
		int "RFM95 NSS GPIO"
		range 0 LoRaWAN_GPIO_RANGE_MAX
		default  5 if IDF_TARGET_ESP32
		default 34 if IDF_TARGET_ESP32S2 || IDF_TARGET_ESP32S3
		default  1 # C3 and others
		help
			Pin Number to be used as the CSN SPI signal.

	config LoRaWAN_RST_GPIO
		int "RFM95 RESTE GPIO"
		range 0 LoRaWAN_GPIO_RANGE_MAX
		default 16 if IDF_TARGET_ESP32
		default 38 if IDF_TARGET_ESP32S2 || IDF_TARGET_ESP32S3
		default  0 # C3 and others
		help
			Pin Number to be used as the RESET signal.

	choice LoRaWAN_SPI_HOST
		prompt "SPI peripheral that controls this bus"
		default VSPI_HOST
		help
			Select SPI peripheral that controls this bus.
		config HSPI_HOST
			bool "HSPI_HOST"
			help
				Use SPI2_HOST. This is also called HSPI_HOST.
		config VSPI_HOST
			depends on IDF_TARGET_ESP32 || IDF_TARGET_ESP32S2 || IDF_TARGET_ESP32S3
			bool "VSPI_HOST"
			help
				USE SPI3_HOST. This is also called VSPI_HOST
	endchoice
	
	config LoRaWAN_DIO0
		int "DIO0 GPIO"
		range 0 LoRaWAN_GPIO_RANGE_MAX
		default 26
		
	config LoRaWAN_DIO1
		int "DIO1 GPIO"
		range 0 LoRaWAN_GPIO_RANGE_MAX
		default 35	
	
	config LoRaWAN_AppEUI
		string "AppEUI/JoinEUI"
		
	config LoRaWAN_DevEUI
		string "DevEUI"
		
	config LoRaWAN_AppKey
		string "AppKey"
	
	config LoRaWAN_SEND_INTERVAL
		int "Send Interval (s)"
		range 60 86400
		default 60
		help
			Interval frecuency to send data.

endmenu
```

## ESP32/components/uart_app/Kconfig.projbuild
```kconfig
menu "UART Application Configuration"

    orsource "$IDF_PATH/examples/common_components/env_caps/$IDF_TARGET/Kconfig.env_caps"

    config UART_APP_BAUD_RATE
        int "UART communication speed"
        range 1200 115200
        default 115200
        help
            UART communication speed for the application.

    config UART_APP_RXD
        int "UART RXD pin number"
        range ENV_GPIO_RANGE_MIN ENV_GPIO_IN_RANGE_MAX
        default 5
        help
            GPIO number for UART RX pin. See UART documentation for more information
            about available pin numbers for UART.

    config UART_APP_TXD
        int "UART TXD pin number"
        range ENV_GPIO_RANGE_MIN ENV_GPIO_OUT_RANGE_MAX
        default 4
        help
            GPIO number for UART TX pin. See UART documentation for more information
            about available pin numbers for UART.

    config UART_APP_RX_BUFFER_SIZE
        int "RX listener buffer"
        range 64 16384
        default 1024
        help
            Defines stack size for UART TX and RX tasks. Insufficient stack size can cause crash.

endmenu
```
